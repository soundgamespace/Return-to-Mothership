
#include <PCM.h>

//sketch for LED charging station

#define redpin 5
#define greenpin 3
#define bluepin 6
//#define irpin 12

const unsigned char colorStation[] PROGMEM = {
 125, 128, 128, 126, 127, 127, 128, 127, 126, 128, 127, 127,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 128, 
 };
const unsigned char chargingStation[] PROGMEM = {
  126, 130, 127, 122, 131, 131, 121, 129, 132, 123, 128, 131,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 128, 
};

void setup() {
  // set ledpins to output
  pinMode(redpin, OUTPUT);
  pinMode(bluepin, OUTPUT);
  pinMode(greenpin, OUTPUT);
  //  pinMode(irpin, OUTPUT);
  //digitalWrite(irPin, HIGH);
}

void dorment(int time) {
  for (int i = 0; i < 255; i = i + 4) {
    analogWrite(redpin, i);
    analogWrite(bluepin, 255 - i);
    delay(time);
  }
  for (int i = 0; i < 255; i = i + 4) {
    analogWrite(greenpin, i);
    analogWrite(redpin, 255 - i);
    delay(time);
  }
  for (int i = 0; i < 255; i = i + 4) {
    analogWrite(bluepin, i);
    analogWrite(greenpin, 255 - i);
    delay(time);
  }
}

void blinker(int time) {
  digitalWrite(bluepin, LOW);
  digitalWrite(redpin, HIGH);
  delay(time);
  digitalWrite(redpin, LOW);
  digitalWrite(greenpin, HIGH);
  delay(time);
  digitalWrite(greenpin, LOW);
  digitalWrite(bluepin, HIGH);
  delay(time);
}

void loop() {
  startPlayback(colorStation, sizeof(colorStation));
  for (int i = 10; i < 18; i++) {
    dorment(i);
  }
    startPlayback(chargingStation, sizeof(chargingStation));
  for (int i = 10; i < 18; i++) {
    dorment(i);
  }
  
}
