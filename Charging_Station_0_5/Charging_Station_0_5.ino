#include <NewPing.h>
#include <PCM.h>

//sketch for LED charging station

#define redpin 3
#define greenpin 5
#define bluepin 6
#define ampPWR 12
#define TRIGGER_PIN 8
#define ECHO_PIN 7
#define MAX_DISTANCE 200

int uS;
int distance;

const unsigned char colorStation[] PROGMEM = {
  126, 127, 128, 129, 127, 127, 127, 128, 128, 128, 128, 128,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 128,
};
const unsigned char chargingStation[] PROGMEM = {
  126, 130, 127, 122, 131, 131, 121, 129, 132, 123, 128, 131,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 128,
};

NewPing sonar(TRIGGER_PIN, ECHO_PIN, MAX_DISTANCE);

void setup() {
  Serial.begin(115200);
  // set ledpins to output
  pinMode(ampPWR, OUTPUT);
  pinMode(redpin, OUTPUT);
  pinMode(bluepin, OUTPUT);
  pinMode(greenpin, OUTPUT);
  //  pinMode(irpin, OUTPUT);
  //digitalWrite(irPin, HIGH);
  speakerTest();
}

void dorment(int time) {
  for (int i = 0; i < 255; i = i + 4) {
    analogWrite(redpin, i);
    analogWrite(bluepin, 255 - i);
    delay(time);
  }
  for (int i = 0; i < 255; i = i + 4) {
    analogWrite(greenpin, i);
    analogWrite(redpin, 255 - i);
    delay(time);
  }
  for (int i = 0; i < 255; i = i + 4) {
    analogWrite(bluepin, i);
    analogWrite(greenpin, 255 - i);
    delay(time);
  }
}

void blinker(int time) {
  digitalWrite(bluepin, LOW);
  digitalWrite(redpin, HIGH);
  delay(time);
  digitalWrite(redpin, LOW);
  digitalWrite(greenpin, HIGH);
  delay(time);
  digitalWrite(greenpin, LOW);
  digitalWrite(bluepin, HIGH);
  delay(time);
}


void speakerTest() {
  digitalWrite(ampPWR, HIGH);
  for (int i = 150; i > 30; i = i - 5) {
    startPlayback(colorStation, sizeof(colorStation));
    delay(i);
    startPlayback(chargingStation, sizeof(chargingStation));
    delay(i);
  }
  delay(10);
  startPlayback(chargingStation, sizeof(chargingStation));
  delay(1500);
  digitalWrite(ampPWR, LOW);
  //
}

void loop() {
  uS = sonar.ping();
  distance = uS / US_ROUNDTRIP_CM;
  Serial.print("Ping: ");
  Serial.print(distance);
  Serial.println("cm");
  if (distance < 100) {
    digitalWrite(ampPWR, HIGH);
    if (distance % 2 == 1) {
      startPlayback(colorStation, sizeof(colorStation));
    }
    else {
      startPlayback(chargingStation, sizeof(chargingStation));
    }
    dorment(20);
    digitalWrite(ampPWR, LOW);
    for (int i = 10; i < 19; i++) {
      dorment(i);
    }
  }
}
